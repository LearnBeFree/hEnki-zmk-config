// Copyright (c) 2022 The ZMK Contributors
// Keyboard layout designed to work with my custom Russian and English layouts
// SPDX-License-Identifier: MIT

#include <behaviors.dtsi>
#include <dt-bindings/zmk/keys.h>
#include <dt-bindings/zmk/bt.h>
#include "zmk-helpers/helper.h"
#include "zmk-helpers/key-labels/42.h"                                      // Source key-labels.

#define KEYS_L LT0 LT1 LT2 LT3 LT4 LT5 LM0 LM1 LM2 LM3 LM4 LM5 LB0 LB1 LB2 LB3 LB4 LB5  // Left-hand keys.
#define KEYS_R RT0 RT1 RT2 RT3 RT4 RT5 RM0 RM1 RM2 RM3 RM4 RM5 RB0 RB1 RB2 RB3 RB4 RB5  // Right-hand keys.
#define THUMBS LH2 LH1 LH0 RH0 RH1 RH2                                      // Thumb keys.

#define MAKE_HRM(NAME, HOLD, TAP, TRIGGER_POS)                                 \
  ZMK_HOLD_TAP(NAME, bindings = <HOLD>, <TAP>; flavor = "balanced";            \
               tapping-term-ms = <280>; quick-tap-ms = <175>;         \
               require-prior-idle-ms = <150>; hold-trigger-on-release;         \
               hold-trigger-key-positions = <TRIGGER_POS>;)

MAKE_HRM(hml, &kp, &kp, KEYS_R THUMBS) // Left-hand HRMs.
MAKE_HRM(hmr, &kp, &kp, KEYS_L THUMBS) // Right-hand HRMs.

#define BRML(k1,k2) &hml LGUI k1  &hml LALT k2
#define BRMR(k1,k2) &hmr RALT k1  &hmr RGUI k2

&caps_word {
    continue-list = <UNDERSCORE MINUS SLASH SEMI LBKT SQT>;
	mods = <(MOD_LSFT | MOD_LALT | MOD_RSFT | MOD_RALT)>;
};


#define COMBO(NAME, BINDINGS, KEYPOS, LAYERS) \
    combo_##NAME { \
        timeout-ms = <50>; \
        bindings = <BINDINGS>; \
        key-positions = <KEYPOS>; \
        layers = <LAYERS>; \
    };



/ {
    behaviors {
        // ht: hold_tap {
        //     label = "hold_tap";
        //     compatible = "zmk,behavior-hold-tap";
        //     #binding-cells = <2>;
        //     flavor = "tap-preferred";
        //     tapping-term-ms = <250>;
        //     quick-tap-ms = <350>;
        //     bindings = <&kp>, <&kp>;
        // };
        tt: thumb_hold_tap {
            label = "thumb_hold_tap";
            compatible = "zmk,behavior-hold-tap";
            #binding-cells = <2>;
            flavor = "tap-preferred";
            tapping_term_ms = <150>;
            quick_tap_ms = <250>;
            bindings = <&mo>, <&kp>;
        };
    };

    conditional_layers {
        compatible = "zmk,conditional-layers";
        adjust_layer {
            if-layers = <2 3>;
            then-layer = <4>;
        };
    };

        //╭──────┬──────┬──────┬──────┬──────┬──────╮   ╭──────┬──────┬──────┬──────┬──────╮──────╮
        //│  0   │  1   │  2   │  3   │  4   │  5   │   │  6   │  7   │  8   │  9   │  10  │  11  │
        //├──────├──────┼──────┼──────┼──────┼──────┤   ├──────┼──────┼──────┼──────┼──────┤──────┤
        //│  12  │  13  │  14  │  15  │  16  │  17  │   │  18  │  19  │  20  │  21  │  22  │  23  │
        //├──────├──────┼──────┼──────┼──────┼──────┤   ├──────┼──────┼──────┼──────┼──────┤──────┤
        //│  24  │  25  │  26  │  27  │  28  │  29  │   │  30  │  31  │  32  │  33  │  34  │  35  │
        //╰──────╰──────┴──────┼──────┼──────┼──────┤   ├──────┼──────┼──────┼──────┴──────╯──────╯
        //                     |  36  |  37  |  38  |   |  39  |  40  |  41  |
        //                     ╰──────┴──────┴──────╯   ╰──────┴──────┴──────╯

	combos {
        compatible = "zmk,combos";
        COMBO(hard,         &kp LS(W),         2 3,        0)
        COMBO(iii,          &kp LS(O),         8 9,        0)
    };

    keymap {
        compatible = "zmk,keymap";

        // - 0
        default_layer {
            display-name = "MAIN";
            bindings = <
        //╭──────────╭──────────┬──────────┬──────────┬──────────┬──────────╮   ╭──────────┬──────────┬──────────┬──────────┬──────────╮──────────╮
        //│          │  Q       │  W       │  E       │  R       │  T       │   │  Y       │  U       │  I       │  O       │  P       │  [       │
            &kp GRAVE   &kp Q      &kp W      &kp E      &kp R      &kp T          &kp Y      &kp U      &kp I      &kp O      &kp P      &kp LBKT
        //├──────────├──────────┼──────────┼──────────┼──────────┼──────────┤   ├──────────┼──────────┼──────────┼──────────┼──────────┤──────────┤
        //│  ESC     │  A       │  S       │  D       │  F       │  G       │   │  H       │  J       │  K       │  L       │  ;       │  '       │
            &kp ESC     &kp A     &kp S     &kp D     &kp F      &kp G          &kp H      &kp J      &kp K      &kp L      &kp SEMI  &kp SQT
        //├──────────├──────────┼──────────┼──────────┼──────────┼──────────┤   ├──────────┼──────────┼──────────┼──────────┼──────────┤──────────┤
        //│ SHIFT    │  Z       │  X       │  C       │  V       │  B       │   │  N       │  M       │ , <      │ . >      │ / ?      │  SHIFT   │
           &kp LSHFT    BRML(Z,      X)      &kp C      &kp V      &kp B          &kp N      &kp M      &kp COMMA  BRMR(DOT,    FSLH)  &kp RSHFT
        //╰──────────╰──────────┴──────────┴──────────┼──────────┼──────────┤   ├──────────┼──────────┼──────────┴──────────┴──────────┴──────────╯
                                           &mt LCTRL TAB &tt 1 SPACE &tt 3 RET  &tt 2 BSPC &tt 1 SPACE &mt RCTRL TAB
        //                                 ╰──────────┴──────────┴──────────╯   ╰──────────┴──────────┴──────────╯
            >;
        };

        // - 1
		symbol_layer {
				display-name = "SYM";
				bindings = <
//___________________________________________________________________________________________              ___________________________________________________________________________________________
//|      `       |      [       |      ^       |      $       |      ]       |      %       |              |      &       |      =       |      -       |      +       |      *       |              |
  &kp RA(GRAVE)  &kp RA(Q)      &kp RA(W)      &kp RA(E)      &kp RA(R)      &kp RA(T)                     &kp RA(Y)      &kp RA(U)      &kp RA(I)      &kp RA(O)      &kp RA(P)      &none           
//___________________________________________________________________________________________              ___________________________________________________________________________________________
//|              |      (       |      '       |      :       |      )       |      #       |              |      !       |      <       |      _       |      ?       |      >       |      0       |
  &kp ESC        &kp RA(A)      &kp RA(S)      &kp RA(D)      &kp RA(F)      &kp RA(G)                     &kp RA(H)      &kp RA(J)      &kp RA(K)      &kp RA(L)      &kp RA(SEMI)   &kp RA(SQT)
//___________________________________________________________________________________________              ___________________________________________________________________________________________
//|              |      {       |      "       |      ;       |      }       |       @      |              |      |       |      \       |              |              |              |              |
  &kp LSHFT     BRML(RA(Z),      RA(X))        &kp RA(C)      &kp RA(V)      &kp RA(B)                     &kp RA(N)      &kp RA(M)      &kp RA(COMMA)  BRMR(RA(DOT),    RA(FSLH))    &kp RSHFT   
//                                             ______________________________________________              ______________________________________________
//                                             |              |              |              |              |              |              |              |
											   &mt LCTRL LANG1      &kp SPACE      &kp RET                        &kp BSPC    &kp SPACE      &mt RCTRL LANG2         
				>;
		};

        // - 2
		num_layer {
				display-name = "NUM";
				bindings = <
//___________________________________________________________________________________________              ___________________________________________________________________________________________
//|      `       |      [       |      ^       |      $       |      ]       |      %       |              |      &       |      =       |      -       |      +       |      *       |              |
  &kp RA(GRAVE)  &kp RA(Q)      &kp RA(W)      &kp RA(E)      &kp RA(R)      &kp RA(T)                     &kp RA(Y)      &kp RA(U)      &kp RA(I)      &kp RA(O)      &kp RA(P)      &none           
//___________________________________________________________________________________________              ___________________________________________________________________________________________
//|              |      1       |      2       |      3       |      4       |      5       |              |      6       |      7       |      8       |      9       |      0       |              |
  &trans         &kp N1    &kp N2         &kp N3         &kp N4         &kp N5                             &kp N6      &kp N7    &kp N8         &kp N9         &kp N0         &kp RA(SQT)         
//___________________________________________________________________________________________              ___________________________________________________________________________________________
//|              |      {       |      "       |      ;       |      }       |       @      |              |      |       |      \       |              |              |              |              |
  &kp LSHFT     BRML(RA(Z),      RA(X))        &kp RA(C)      &kp RA(V)      &kp RA(B)                     &kp RA(N)      &kp RA(M)      &kp RA(COMMA)  BRMR(RA(DOT),    RA(FSLH))    &kp RSHFT   
//                                             ______________________________________________              ______________________________________________
//                                             |              |              |              |              |              |              |              |
											   &kp LCTRL       &kp SPACE      &kp RET                        &kp BSPC    &kp SPACE      &kp RCTRL          
				>;
		};

        // - 3 TODO IDK how to do mods at this layer
		nav_layer {
				display-name = "NAV";
				bindings = <
//__________________________________________________________________________________________________               _________________________________________________________________________________________________
// |     F12       |      F1       |     F2        |     F3        |      F4       |      F5       |               |     F6        |     F7        |     F8        |     F9        |     F10       |     F11       |
   &kp F12         &kp F1          &kp F2          &kp F3          &kp F4          &kp F5                          &kp F6          &kp F7          &kp F8          &kp F9          &kp F10         &kp F11         
// _________________________________________________________________________________________________               _________________________________________________________________________________________________
// |               |      META     |      ALT      |   SHIFT       |      CTRL     |               |               |     HOME      |     LEFT      |      DOWN     |     UP        |     RIGHT     |     END       |
   &none           &kp LGUI        &kp LALT        &kp LSHFT       &kp LCTRL       &none                           &kp HOME        &kp LEFT        &kp DOWN        &kp UP          &kp RIGHT       &kp END 
// _________________________________________________________________________________________________               _________________________________________________________________________________________________
// |               |               |      DEL      |               |     INS       |               |               |               |               |     PGDOWN    |     PGUP      |               |               |
   &none           &none           &kp DEL         &none           &kp INS         &none                           &none           &none           &kp PG_DN       &kp PG_UP       &none           &none          
//                                                 _________________________________________________               _________________________________________________
//                                                 |     ADJ       |               |               |               |               |               |     ADJ       |                             
									               &trans         &kp SPACE      &trans                        &trans         &kp SPACE      &none                            
				>;
		};

        // - 4
        adjust_layer {
            display-name = "ADJ";
            bindings = <
        //╭──────────╭──────────┬──────────┬──────────┬──────────┬──────────╮   ╭──────────┬──────────┬──────────┬──────────┬──────────╮──────────╮
        //│          │  RESET   │          │          │          │PROFILE 0 │   │          │          │          │          │  RESET   │          │
            &trans    &sys_reset  &trans     &trans     &trans    &bt BT_SEL 0    &trans     &trans     &trans     &trans    &sys_reset  &trans
        //├──────────├──────────┼──────────┼──────────┼──────────┼──────────┤   ├──────────┼──────────┼──────────┼──────────┼──────────┤──────────┤
        //│          │BOOTLOADER│          │          │          │PROFILE 1 │   │          │          │          │          │BOOTLOADER│          │
            &trans   &bootloader  &trans     &trans     &trans    &bt BT_SEL 1    &trans   &kp Q     &trans     &trans    &bootloader &trans
        //├──────────├──────────┼──────────┼──────────┼──────────┼──────────┤   ├──────────┼──────────┼──────────┼──────────┼──────────┤──────────┤
        //│          │ CLEAR BT │          │          │          │PROFILE 2 │   │          │          │          │          │          │          │
            &trans     &bt BT_CLR  &trans     &trans    &trans    &bt BT_SEL 2    &trans     &trans     &trans     &trans     &trans     &trans
        //╰──────────╰──────────┴──────────┴──────────┼──────────┼──────────┤   ├──────────┼──────────┼──────────┴──────────┴──────────╯──────────╯
                                             &trans     &trans     &trans         &trans     &trans     &trans
        //                                 ╰──────────┴──────────┴──────────╯   ╰──────────┴──────────┴──────────╯
            >;
        };

    };
};
